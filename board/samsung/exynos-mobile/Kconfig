## board/samsung/exynos-mobile/Kconfig
```kconfig
if TARGET_EXYNOS_MOBILE

config ENV_SOURCE_FILE
	default "exynos-mobile"

config LNX_KRNL_IMG_TEXT_OFFSET_BASE
	default 0x80000000 if EXYNOS_MOBILE_A51
	default TEXT_BASE

config SYS_BOARD
	default "exynos-mobile"

config SYS_CONFIG_NAME
	default "exynos-mobile"

config SYS_VENDOR
	default "samsung"

config EXYNOS_MOBILE_A51
	bool "Samsung Galaxy A51 (Exynos 9611) S-BOOT support"
	select EVENT
	help
	  Log the PMU reset reason (RST_STAT) and the S-BOOT INFORM2/INFORM3
	  registers at boot, export them as the rst_stat and reset_reason
	  environment variables, and add the "sboot" command, which resets
	  into an S-BOOT target (normal, download, upload, recovery). Also
	  sets the DECON trigger so the simple-framebuffer shows on the panel.
	  With TEXT_BASE 0x80080000 the image header says text_offset 0x80000
	  like the stock kernel, so S-BOOT does not load u-boot at the DRAM
	  base (reserved sec-debug-magic/kaslr pages).

config EXYNOS_MOBILE_A51_WDT
	bool "Arm the A51 CPUCL0 watchdog early"
	depends on EXYNOS_MOBILE_A51
	help
	  Arm WDT_CPUCL0 (resets the SoC on expiry) at the first board hook of
	  board_init_f. Nothing in u-boot feeds it: the kernel has to take it
	  over (s3c2410_wdt.tmr_atboot=1), or the device resets. The A51 this
	  is for has a dead power key, so this is the only way out of a hang.

config EXYNOS_MOBILE_A51_WDT_SEC
	int "Watchdog timeout in seconds (0 = the longest possible, ~82 s)"
	depends on EXYNOS_MOBILE_A51_WDT
	default 0

config EXYNOS_MOBILE_A51_WDT_TEST
	bool "Watchdog test: wait for the reset instead of booting"
	depends on EXYNOS_MOBILE_A51_WDT

config EXYNOS_MOBILE_A51_FAILSAFE
	bool "Boot-loop / watchdog escape into the other S-BOOT slot"
	depends on EXYNOS_MOBILE_A51_WDT
	help
	  For u-boot started by S-BOOT directly. After a watchdog reset of
	  this slot, or after MAX_BOOTS boots without the kernel's init
	  clearing the boot counter, reset into the other slot (BOOT <->
	  RECOVERY). Uses the same scratch words as uniLoader's failsafe, so
	  do not enable it behind uniLoader: both would count every boot.

config EXYNOS_MOBILE_A51_FAILSAFE_SLOT
	int "Slot this image is flashed to (0 = BOOT, 1 = RECOVERY)"
	depends on EXYNOS_MOBILE_A51_FAILSAFE
	range 0 1
	default 1

config EXYNOS_MOBILE_A51_FAILSAFE_SCRATCH
	hex "Scratch address (3 words, must survive a reset and be reserved)"
	depends on EXYNOS_MOBILE_A51_FAILSAFE
	default 0xfa70f000

config EXYNOS_MOBILE_A51_FAILSAFE_MAX_BOOTS
	int "Boots without reaching init before escaping"
	depends on EXYNOS_MOBILE_A51_FAILSAFE
	default 3

endif # TARGET_EXYNOS_MOBILE
```

## configs/a51_defconfig
```kconfig
CONFIG_ARM=y
CONFIG_SKIP_LOWLEVEL_INIT=y
CONFIG_COUNTER_FREQUENCY=26000000
CONFIG_POSITION_INDEPENDENT=y
CONFIG_ARCH_EXYNOS=y
CONFIG_SYS_MALLOC_LEN=0x2000000
CONFIG_SYS_MALLOC_F_LEN=0x16000
CONFIG_TARGET_EXYNOS_MOBILE=y
CONFIG_EXYNOS_MOBILE_A51=y
CONFIG_NR_DRAM_BANKS=6
CONFIG_DEFAULT_DEVICE_TREE="exynos/exynos9611-a51"
CONFIG_SYS_BOOTM_LEN=0x2000000
CONFIG_SYS_LOAD_ADDR=0x80080000
CONFIG_ARMV8_CNTFRQ_BROKEN=y
# CONFIG_PSCI_RESET is not set
CONFIG_SYS_PBSIZE=1024
# CONFIG_DISPLAY_CPUINFO is not set
CONFIG_HUSH_PARSER=y
CONFIG_OF_UPSTREAM=y
CONFIG_OF_UPSTREAM_BUILD_VENDOR=y
CONFIG_OF_BOARD=y
CONFIG_SAVE_PREV_BL_FDT_ADDR=y
CONFIG_SAVE_PREV_BL_INITRAMFS_START_ADDR=y
CONFIG_A51_RAMLOG_SERIAL=y
CONFIG_SERIAL_PUTS=y
CONFIG_VIDEO=y
# CONFIG_VIDEO_FONT_8X16 is not set
CONFIG_VIDEO_FONT_16X32=y
CONFIG_VIDEO_SIMPLE=y
```
